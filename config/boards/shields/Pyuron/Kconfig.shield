## config/boards/shields/Pyuron/Kconfig.shield
```kconfig
config SHIELD_PYURON_R
    def_bool $(shields_list_contains,Pyuron_R)

config SHIELD_PYURON_L
    def_bool $(shields_list_contains,Pyuron_L)
```

## config/boards/shields/cool640db/Kconfig.defconfig
```kconfig
if SHIELD_COOL640DB_R

config ZMK_KEYBOARD_NAME
    default "cool640db_R"

config ZMK_SPLIT
    default y

config ZMK_SPLIT_ROLE_CENTRAL
    default y

endif

if SHIELD_COOL640DB_L

config ZMK_KEYBOARD_NAME
    default "cool640db_L"

config ZMK_SPLIT
    default y

endif
```

## config/boards/shields/cool640db/Kconfig.shield
```kconfig
config SHIELD_cool640db_R
    def_bool $(shields_list_contains,cool640db_R)

config SHIELD_cool640db_L
    def_bool $(shields_list_contains,cool640db_L)
```
